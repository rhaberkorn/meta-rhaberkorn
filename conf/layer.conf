## conf/layer.conf
```bitbake
# We have a conf and classes directory, add to BBPATH
BBPATH .= ":${LAYERDIR}"

# We have recipes-* directories, add to BBFILES
BBFILES += "${LAYERDIR}/recipes-*/*/*.bb \
	${LAYERDIR}/recipes-*/*/*.bbappend"

BBFILE_COLLECTIONS += "rhaberkorn"
BBFILE_PATTERN_rhaberkorn = "^${LAYERDIR}/"
BBFILE_PRIORITY_rhaberkorn = "6"

LAYERSERIES_COMPAT_rhaberkorn = "kirkstone"
```
